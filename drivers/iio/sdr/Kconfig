## drivers/iio/sdr/Kconfig
```kconfig
# SPDX-License-Identifier: GPL-2.0-only
#
# SDRs
#
# When adding new entries keep the list in alphabetical order

menu "SDRs"

config SKYNET_RX
	tristate "Skynet_RX"
	select IIO_BUFFER
	select IIO_TRIGGERED_BUFFER
	help
	  Say yes to choose the Skynet_RX.

	  To compile this driver as a module, choose M here: the
	  module will be called Skynet_RX.

config SKYNET_TX
	tristate "Skynet_TX"
	select IIO_BUFFER
	select IIO_TRIGGERED_BUFFER
	help
	  Say yes to choose the Skynet_TX.

	  To compile this driver as a module, choose M here: the
	  module will be called Skynet_TX.

endmenu
```
